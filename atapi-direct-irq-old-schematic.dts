/dts-v1/;
/plugin/;

/ {
	compatible = "brcm,bcm2835", "brcm,bcm2708", "brcm,bcm2709", "brcm,bcm2911";

	fragment@0 {
		target = <&gpio>;

		__overlay__ {
			pata_irq_pin: pata-irq-pin {
				brcm,pins = <26>;
				brcm,function = <0>; /* GPIO, input */
				brcm,pull = <1>;
			};
		};
	};

	fragment@1 {
		target-path = "/";
		__overlay__ {
			pata-gpio {
				compatible = "pata-gpio";

				address-gpios = <
					&gpio 13 0
					&gpio 6 0
					&gpio 1 0
					>;

				cs-gpios = <
					&gpio 19 1
					&gpio 12 1
					>;

				databus-gpios = <
					&gpio 11 0
					&gpio 9 0
					&gpio 10 0
					&gpio 22 0
					&gpio 27 0
					&gpio 17 0
					&gpio 4 0
					&gpio 3 0
					&gpio 16 0
					&gpio 20 0
					&gpio 18 0
					&gpio 23 0
					&gpio 24 0
					&gpio 25 0
					&gpio 8 0
					&gpio 7 0
					>;

				interrupts = <26 0x01>; /* GPIO26, rising edge */
				interrupt-parent = <&gpio>;

				pinctrl-default = <&pata_irq_pin>;
				pinctrl-names = "default";

				reset-gpio = <&gpio 2 1>;

				strobe-read-gpio = <&gpio 5 1>;
				strobe-write-gpio = <&gpio 0 1>;

				status = "okay";
			};
		};
	};
};
