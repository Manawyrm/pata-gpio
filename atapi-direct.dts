/dts-v1/;
/plugin/;

/ {
	compatible = "brcm,bcm2835", "brcm,bcm2708", "brcm,bcm2709", "brcm,bcm2911";

	fragment@0 {
		target-path = "/";
		__overlay__ {
			pata-gpio {
				compatible = "pata-gpio";

				address-gpios = <
					&gpio 5 0
					&gpio 4 0
					&gpio 3 0
					>;

				cs-gpios = <
					&gpio 2 1
					&gpio 1 1
					>;

				databus-gpios = <
					&gpio 8 0
					&gpio 9 0
					&gpio 10 0
					&gpio 11 0
					&gpio 12 0
					&gpio 13 0
					&gpio 14 0
					&gpio 15 0
					&gpio 16 0
					&gpio 17 0
					&gpio 18 0
					&gpio 19 0
					&gpio 20 0
					&gpio 21 0
					&gpio 22 0
					&gpio 23 0
					>;

				reset-gpio = <&gpio 26 1>;

				strobe-read-gpio = <&gpio 6 1>;
				strobe-write-gpio = <&gpio 7 1>;

				status = "okay";
			};
		};
	};
};
